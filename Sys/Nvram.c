/******************************************************************************/
/*                       Novatek MicroElectronics Corp.                       */
/*       6F, No. 1-2, Innovation Road I, Science-Based Industrial Park,       */
/*                         HsinChu 300, Taiwan, R.O.C.                        */
/*                 TEL:886-3-567-0889       FAX:886-3-577-0132                */
/*                            All Rights Reserved                             */
/******************************************************************************/

//******************************************************************************
// I N C L U D E   F I L E S
//******************************************************************************
#include "Include.h"

//******************************************************************************
// M A C R O   D E F I N I T I O N S
//******************************************************************************

//******************************************************************************
// G L O B A L   V A R I A B L E S
//******************************************************************************
/*!
 * Default value of user data.
 */
code NvramUserData UserDataDefault = {
    0x00, //UCHAR bICare : 1;
    0x01, //UCHAR bPowerStatus : 1;
    0x00, //UCHAR bOSDLock : 1;
    0x01, //UCHAR bDDCCI : 1;
    0x00, //UCHAR bAudioMute : 1;
    0x01, //UCHAR bGammaOnOff : 1;
    0x00, //UCHAR bDCRMode : 1;
    DEF_DBCMode, //UCHAR bDBCMode : 1;
    0x00, //UCHAR bLDOnOff : 1;
#if ENABLE_HDMI_PRETEST == ON || ENABLE_AUTO_CONTROL == ON
    0x00, //UCHAR bAutoSyncSource : 1;
    0x00, //UCHAR bPIPAutoSyncSource : 1;
#else
    DEFAULT_AUTOSORUCE, //UCHAR bAutoSyncSource : 1;
    0x00, //UCHAR bPIPAutoSyncSource : 1;
#endif
#if ENABLE_AUTO_POVIT_FUNC == ON      
    0x01, //UCHAR bAutoPivot : 1;
#endif
    0x00, //UCHAR bOSDRotation : 1;
    0x00, //UCHAR bOverScan : 1;
    0x01, //UCHAR bSOGOverScan : 1; 
#if ENABLE_DUAL_370 == OFF
    0x00, //UCHAR bDPSpeed : 1;
#else
    0x01, //UCHAR bDPSpeed : 1;
#endif
    0x00, //UCHAR ucDCRMode;
    0x00,//UCHAR bBrightFrame : 1;
    0x00,//UCHAR bDemo : 1;
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    0x01,//UCHAR bSRS3D: 1;
#if ENABLE_DUAL_370
    0x00,//    UCHAR bPIPSWAP : 1;
#endif    
#if TPV_DP_VERSION_SELECT == ON
    DP_1_2,//UCHAR bDPversion:1;
#endif
    DEFAULT_SensEyeDemo,//UCHAR bSensEyeDemo : 1
    COLOR_YUV,//UCHAR bColorFormat : 1        
    ON,//UCHAR bHDMIAutoSwitch : 1
    DEFAULT_DPAUTOSWITCH,//UCHAR bDPAutoSwitch : 1    
    ON, //UCHAR bResNotice : 1    
    OFF,//UCHAR bSmartReminder : 1;  
    0x00, //bSeviceMenu :1
#if ENABLE_EYE_PROTECT == ON
    OFF,//UCHAR bEyePortect : 1;
    OFF,//UCHAR bEyeProtectMeter : 1;
#endif   
#if ENABLE_ECO_SENSOR == ON                                       
    OFF,    //UCHAR bECOSensor : 1;
    OFF,    //UCHAR bECOSensorMeter : 1;
    0x02,//ECO_SENSOR_RANGE_FAR,   //UCHAR ucSensorRange
#endif    
    DEFAULT_COLOR_AUTO,
#if ENABLE_SMART_SCALING == ON
    0x00, //ucSmartScaling;
#endif
    0x00, //ucUserDefVideoSource 
    DEFLANG, //UCHAR ucLanguage;  //v31_110902_1150_SYS#1
#if ENABLE_EYE_PROTECT == ON
    0x32, //UCHAR ucEyeProtectBrightness
#endif    
    DEF_BRIGHTNESS,//UCHAR ucBrightness;   
    0x64, //UCHAR ucBrightness_sRGB;    
    DEF_BRIGHTNESS_STANDARD, //UCHAR ucBrightness_Standard;
    MAXBRI_LBL_MULTIMEDIA,//0x64, //UCHAR ucBrightness_LBL_Mult;
    MAXBRI_LBL_WEB_SURFING, //UCHAR ucBrightness_LBL_Web;    
    MAXBRI_LBL_OFFICE,//0x24,//0x64, //UCHAR ucBrightness_LBL_Office;
    MAXBRI_LBL_READING, //UCHAR ucBrightness_LBL_Read;
#if ENABLE_PICTURE_MODE_MOVIE == ON                           
    0x64, //UCHAR ucBrightness_Movie;
#endif
#if ENABLE_PICTURE_MODE_GAME == ON                    
    0x64, //UCHAR ucBrightness_Game;    
#endif    
#if ENABLE_PICTURE_MODE_PHOTO== ON                    
    0x64, //UCHAR ucBrightness_Photo;   
#endif  
    
    0x64, //UCHAR ucBrightness_USER;
    0x64, //UCHAR ucBrightness_MBOOK;
#if	ENABLE_PICTURE_MODE_ANIMATION == ON            
    0x64, //UCHAR ucBrightness_Animation;
#endif
#if	ENABLE_PICTURE_MODE_CAD == ON    
    DEF_BRIGHTNESS_CAD, //UCHAR ucBrightness_CAD;
#endif
#if	ENABLE_PRESENTATION_MODE == ON        
    0x64, //UCHAR ucBrightness_Presentation;    
#endif    
#if ENABLE_PICTURE_MODE_REC709 == ON                                   
    DEF_BRIGHTNESS_REC709, //ucBrightness_Rec709;
#endif  
#if ENABLE_PICTURE_MODE_DARKROOM == ON                                   
    DEF_BRIGHTNESS_DARKROOM, //ucBrightness_DarkRoom;
#endif  
    DEF_CONTRAST, //UCHAR ucContrast;
    0x32, //UCHAR ucContrast_sRGB;
    0x32, //UCHAR ucContrast_Standard;
    0x32, //UCHAR ucContrast_LBL_Mult;
    0x32, //UCHAR ucContrast_LBL_Web;    
    0x32, //UCHAR ucContrast_LBL_Office;
    0x32, //UCHAR ucContrast_LBL_Read;
#if ENABLE_PICTURE_MODE_MOVIE == ON                               
    0x32, //UCHAR ucContrast_Movie;
#endif
#if ENABLE_PICTURE_MODE_GAME == ON                           
    0x32, //UCHAR ucContrast_Game;  
#endif
#if ENABLE_PICTURE_MODE_PHOTO == ON                           
    0x32, //UCHAR ucContrast_Photo;
#endif    
    0x32, //UCHAR ucContrast_USER;
    0x32, //UCHAR ucContrast_MBOOK;
#if	ENABLE_PICTURE_MODE_ANIMATION == ON                
    0x32, //UCHAR ucContrast_Animation;
#endif
#if	ENABLE_PICTURE_MODE_CAD == ON    
    0x32, //UCHAR ucContrast_CAD;
#endif
#if	ENABLE_PRESENTATION_MODE == ON        
    0x32, //UCHAR ucContrast_Presentation;
#endif 
    PICTURE_DUALMODE_SRGB,//ucDualViewMode
#if ENABLE_PICTURE_MODE_REC709 == ON                                   
    0x32, //ucContrast_Rec709;
#endif  
#if ENABLE_PICTURE_MODE_DARKROOM == ON                                   
    0x32, //ucContrast_DarkRoom;
#endif
    0x00, //UCHAR ucDynamicContrast;
    DEF_OSDTimer, //UCHAR ucOSDTimer;
    DEF_OSDPosX, //UCHAR ucOSDX;
    DEF_OSDPosY, //UCHAR ucOSDY;
    DEF_OSDTRANSPARENT, //UCHAR ucOSDTransparent;
    0x1E, //UCHAR ucVolume;
    DEFAULT_COLORTEMP, //UCHAR ucColorTemp;
    DEFAULT_COLORTEMP_SRGB,//UCHAR ucColorTemp_sRGB;    
    DEFAULT_COLORTEMP_STANDARD,//UCHAR ucColorTemp_Standard;
    DEFAULT_COLORTEMP_LBL_MULT,//UCHAR ucColorTemp_LBL_Mult;
    DEFAULT_COLORTEMP_LBL_WEB,//UCHAR ucColorTemp_LBL_Web;    
    DEFAULT_COLORTEMP_LBL_OFFICE,//UCHAR ucColorTemp_LBL_Office;
    DEFAULT_COLORTEMP_LBL_READ,//UCHAR ucColorTemp_LBL_Read;
#if ENABLE_PICTURE_MODE_MOVIE == ON                                   
    DEFAULT_COLORTEMP_MOVIE,//UCHAR ucColorTemp_Movie;
#endif
#if ENABLE_PICTURE_MODE_GAME == ON                         
    DEFAULT_COLORTEMP_GAME,//UCHAR ucColorTemp_Game;    
#endif
#if ENABLE_PICTURE_MODE_PHOTO== ON                               
    DEFAULT_COLORTEMP_PHOTO,//UCHAR ucColorTemp_Photo;    
#endif
    DEFAULT_COLORTEMP_USER,//UCHAR ucColorTemp_USER;
    DEFAULT_COLORTEMP_MBOOK,//UCHAR ucColorTemp_MBOOK;
#if	ENABLE_PICTURE_MODE_ANIMATION == ON        
    DEFAULT_COLORTEMP_ANIMATION,//UCHAR ucColorTemp_Animation;
#endif
#if	ENABLE_PICTURE_MODE_CAD == ON
    DEFAULT_COLORTEMP_CAD,//UCHAR ucColorTemp_CAD;
#endif
#if	ENABLE_PRESENTATION_MODE == ON    
    DEFAULT_COLORTEMP_PRESENTATION,//UCHAR ucColorTemp_Presentation;        
#endif
#if ENABLE_PICTURE_MODE_REC709 == ON                                   
    DEFAULT_COLORTEMP_REC709,//UCHAR ucColorTemp_Rec709;
#endif  
#if ENABLE_PICTURE_MODE_DARKROOM == ON                                   
    DEFAULT_COLORTEMP_DARKROOM,//UCHAR ucColorTemp_DarkRoom;
#endif 
    DEF_UserRGain, //UCHAR ucUserRGain;
    DEF_UserRGain, //UCHAR ucUserGGain;
    DEF_UserRGain, //UCHAR ucUserBGain;
    0x32, //UCHAR ucUserROffset;
    0x32, //UCHAR ucUserGOffset;
    0x32, //UCHAR ucUserBOffset;
    DSP_SIZE_FULL, //UCHAR ucAspectRatio;
    DSP_SIZE_FULL, //UCHAR ucAspectRatio_VGADVIDP;
    DSP_SIZE_FULL, //UCHAR ucAspectRatio_HDMI
    DEFAULT_OD, //UCHAR ucODMode;
    DEFAULT_OD_SRGB,//UCHAR ucODMode_sRGB;    
    DEFAULT_OD_STANDARD,//UCHAR ucODMode_Standard;
    DEFAULT_OD_LBL_MULT,//UCHAR ucODMode_LBL_Mult;
    DEFAULT_OD_LBL_WEB,//UCHAR ucODMode_LBL_Web;    
    DEFAULT_OD_LBL_OFFICE,//UCHAR ucODMode_LBL_Office;
    DEFAULT_OD_LBL_READ,//UCHAR ucODMode_LBL_Read;
#if ENABLE_PICTURE_MODE_MOVIE == ON                                   
    DEFAULT_OD_MOVIE,//UCHAR ucODMode_Movie;
#endif
#if ENABLE_PICTURE_MODE_GAME == ON                         
    DEFAULT_OD_GAME,//UCHAR ucODMode_Game;    
#endif
#if ENABLE_PICTURE_MODE_PHOTO== ON                               
    DEFAULT_OD_PHOTO,//UCHAR ucODMode_Photo;    
#endif
    DEFAULT_OD_USER,//UCHAR ucODMode_USER;
    DEFAULT_OD_MBOOK,//UCHAR ucODMode_MBOOK;
#if	ENABLE_PICTURE_MODE_ANIMATION == ON        
    DEFAULT_OD_ANIMATION,//UCHAR ucODMode_Animation;
#endif
#if	ENABLE_PICTURE_MODE_CAD == ON
    DEFAULT_OD_CAD,//UCHAR ucODMode_CAD;
#endif
#if	ENABLE_PRESENTATION_MODE == ON    
    DEFAULT_OD_PRESENTATION,//UCHAR ucODMode_Presentation;        
#endif
#if ENABLE_PICTURE_MODE_REC709 == ON                                   
    DEFAULT_OD_REC709,//UCHAR ucODMode_Rec709;
#endif  
#if ENABLE_PICTURE_MODE_DARKROOM == ON                                   
    DEFAULT_OD_DARKROOM,//UCHAR ucODMode_DarkRoom;
#endif  
    
#if ENABLE_AUTO_CONTROL == ON
    CE_OFF, //UCHAR ucBFMode;
#else
    PICTURE_MODE_STANDARD, //UCHAR ucBFMode;
#endif
#if ENABLE_HDMI_PRETEST == ON
    MODEL_INPUT_DIG1,//MODEL_INPUT_DIG0: HDMI MODEL_INPUT_DIG1:DP MODEL_INPUT_DIG2:DVI
    0x00, //PIPType
    0x00,
    MODEL_INPUT_VGA0,
#else
    DEFAULT_INPUTSOURCE, //UCHAR ucInputSource;
    0x00, //UCHAR ucAOCPIPPosition;
    0x00, //UCHAR ucPIPMode;
    MODEL_INPUT_DIG0, //UCHAR ucPIPInputSrc;
#endif
    DEFAULT_GAMMA,          //UCHAR ucGammaNum;
    DEFAULT_GAMMA_SRGB,      //UCHAR ucGammaNum_sRGB;    
    DEFAULT_GAMMA_STANDARD,  //UCHAR ucGammaNum_Standard;
    DEFAULT_GAMMA_LBL_MULT,  //UCHAR ucGammaNum_LBL_Mult;
    DEFAULT_GAMMA_LBL_WEB,   //UCHAR ucGammaNum_LBL_Web;    
    DEFAULT_GAMMA_LBL_OFFICE,//UCHAR ucGammaNum_LBL_Office;
    DEFAULT_GAMMA_LBL_READ,  //UCHAR ucGammaNum_LBL_Read;
#if ENABLE_PICTURE_MODE_MOVIE == ON                                   
    DEFAULT_GAMMA_MOVIE,//UCHAR ucGammaNum_Movie;
#endif
#if ENABLE_PICTURE_MODE_GAME == ON                         
    DEFAULT_GAMMA_GAME,//UCHAR ucGammaNum_Game;    
#endif
#if ENABLE_PICTURE_MODE_PHOTO== ON                               
    DEFAULT_GAMMA_PHOTO,//UCHAR ucGammaNum_Photo;    
#endif
    DEFAULT_GAMMA_USER,//UCHAR ucGammaNum_USER;
    DEFAULT_GAMMA_MBOOK,//UCHAR ucGammaNum_MBOOK;
#if	ENABLE_PICTURE_MODE_ANIMATION == ON        
    DEFAULT_GAMMA_ANIMATION,//UCHAR ucGammaNum_Animation;
#endif
#if	ENABLE_PICTURE_MODE_CAD == ON
    DEFAULT_GAMMA_CAD,//UCHAR ucGammaNum_CAD;
#endif
#if	ENABLE_PRESENTATION_MODE == ON    
    DEFAULT_GAMMA_PRESENTATION,//UCHAR ucGammaNum_Presentation;        
#endif
#if ENABLE_PICTURE_MODE_REC709 == ON                                   
    DEFAULT_GAMMA_REC709,//UCHAR ucGammaNum_Rec709;
#endif  
#if ENABLE_PICTURE_MODE_DARKROOM == ON                                   
    DEFAULT_GAMMA_DARKROOM,//UCHAR ucGammaNum_DarkRoom;
#endif  
    0x00, //UCHAR ucBF_HP;
    0x00, //UCHAR ucBF_VP;
    0x00, //UCHAR ucBF_Size;
    0x32, //ucBF_Brightness;
    0x32, //ucBF_Contrast;
    0x00, //ucECOMode;
    0x00, //ucOFFTime;
    DEF_SHARPNESS,
    0x05,//UCHAR ucSharpness_sRGB;
    0x05,//UCHAR ucSharpness_Standard;
    0x05,//UCHAR ucSharpness_LBL_Mult;
    0x05,//UCHAR ucSharpness_LBL_Web;    
    0x05,//UCHAR ucSharpness_LBL_Office;
    0x05,//UCHAR ucSharpness_LBL_Read;
#if ENABLE_PICTURE_MODE_MOVIE == ON                               
    0x06,//UCHAR ucSharpness_Movie;
#endif
#if ENABLE_PICTURE_MODE_GAME == ON                          
    0x07,//UCHAR ucSharpness_Game;
#endif
#if ENABLE_PICTURE_MODE_PHOTO == ON                           
    0x07,//UCHAR ucSharpness_Photo;
#endif    
    0x05,//UCHAR ucSharpness_USER;
    0x05,//UCHAR ucSharpness_MBOOK;
#if	ENABLE_PICTURE_MODE_ANIMATION == ON    
    0x05,//UCHAR ucSharpness_Animation;
#endif
#if	ENABLE_PICTURE_MODE_CAD == ON
    0x05,//UCHAR ucSharpness_CAD;
#endif
#if	ENABLE_PRESENTATION_MODE == ON    
    0x05,//UCHAR ucSharpness_Presentation;
#endif    
#if ENABLE_PICTURE_MODE_REC709 == ON                                   
    0x05,//ucSharpness_Rec709;
#endif  
#if ENABLE_PICTURE_MODE_DARKROOM == ON                                   
    0x05,//ucSharpness_DarkRoom;
#endif
    0x00, //UCHAR ucEView;
    0x00, //UCHAR ucDCBMode;
    0x00, //UCHAR ucBrightAdj;
    INPUT_SC_VGA, //ucUserDefVideo;
    INPUT_SC_YPbPr, //ucUserDefAudio;
    0x00,//UCHAR ucPIPsize
    0x00, //UCHAR ucPIPTrans;
#if ENABLE_3D_CNV == ON 
    0x00, //uc2DTo3DMode;
    0x06, //uc2Dto3DDepth;
    0x06, //uc2Dto3DView;
    0x00, //uc3DCfg;
#endif
    0x00, //ucSRMode;
#if ENABLE_PIP == ON
    0x00, // ucPIPSRMode
#endif
    AUDIOSRC_AUTO, //UCHAR ucAudioSelect
    AUDIOSRC_AUTO, //UCHAR ucDPAudioSelect    
    AUDIOSRC_AUTO, //UCHAR ucHDMIAudioSelect    
    0x32, //UCHAR ucHue;
    0x32, //UCHAR ucSaturation;
    DEF_CUSTOMKEY1, //UCHAR ucCustomerKey1;
    DEF_CUSTOMKEY2, //UCHAR ucCustomerKey2;
    DEF_CUSTOMKEY3, //UCHAR ucCustomerKey3;
    AUTO_POWER_OFF, //UCHAR ucAutoPowerOffTime;
    MULTIMEDIA,//UCHAR ucLBLMode
#if ENABLE_PICTURE_MODE_ANIMATION == ON
    DEF_ANIMATIONMODE,   //UCHAR ucAnimationMode;
#endif    
    ERGO_TIME_20MIN,//UCHAR ucErgoTime;
    ERGO_DURATION_5SEC,//UCHAR ucErgoDuration;    
    0xFFFF, //USHRT usCurrModeHactive;
    0xFFFF, //USHRT usCurrModeVactive;
    0xFFFF, //USHRT usCurrModeVsync;
    0xFFFF, //usCurrModeIndex;
    NVRAM_FIELD_END_FLAG //USHRT usUsrEnd;
};

/*!
 * Default value of calibration data.
 */
code NvramCalibData CalibDataDefault = {
    DEF_ADCRGain, //UCHAR ucADCRGain;
    DEF_ADCGGain, //UCHAR ucADCGGain;
    DEF_ADCBGain, //UCHAR ucADCBGain;
    DEF_ADCROffset, //UCHAR ucADCROffset;
    DEF_ADCGOffset, //UCHAR ucADCGOffset;
    DEF_ADCBOffset, //UCHAR ucADCBOffset;
    0xFF, //UCHAR uc5000KRGain;
    0xFF, //UCHAR uc5000KGGain;
    0xF0, //UCHAR uc5000KBGain;
    DEF_5800KRGain, //UCHAR uc5800KRGain;
    DEF_5800KGGain, //UCHAR uc5800KGGain;
    DEF_5800KBGain, //UCHAR uc5800KBGain;    
    DEF_6500KRGain, //UCHAR uc6500KRGain;
    DEF_6500KGGain, //UCHAR uc6500KGGain;
    DEF_6500KBGain, //UCHAR uc6500KBGain;
    DEF_7500KRGain, //UCHAR uc7500KRGain;
    DEF_7500KGGain, //UCHAR uc7500KGGain;
    DEF_7500KBGain, //UCHAR uc7500KBGain;
    0xF8, //UCHAR uc8200KRGain;
    0xF8, //UCHAR uc8200KGGain;
    0xFF, //UCHAR uc8200KBGain;
    DEF_9300KRGain, //UCHAR uc9300KRGain;
    DEF_9300KGGain, //UCHAR uc9300KGGain;
    DEF_9300KBGain, //UCHAR uc9300KBGain;
    0xF0, //UCHAR uc11500KRGain;
    0xF0, //UCHAR uc11500KGGain;
    0xFF, //UCHAR uc11500KBGain;
    DEF_sRGBRGain, //UCHAR ucsRGBRGain;
    DEF_sRGBGGain, //UCHAR ucsRGBGGain;
    DEF_sRGBBGain, //UCHAR ucsRGBBGain;
    DEF_VcomValue  , //UCHAR ucVcomValue; 
#if ENABLE_NVT_FGA == ON
    0,		//UCHAR ucFGADone;
    0xAA, //UCHAR ucFGACkSumH;
    0x55, //UCHAR ucFGACkSumL;
#endif
    NVRAM_FIELD_END_FLAG //USHRT usCalEnd;
};

/*!
 * Default value of system data.
 */
code NvramSystemData SystemDataDefault = {
	0x01,   //UCHAR bFactory:1;
    0x01,   //UCHAR bBurnIn : 1;
    DEF_SHOWLOGO,   //UCHAR bShowLogo : 1;
    0x01,   //UCHAR bEnableOnOffHPD : 1;
    0x00,  //bHDMI_PRETEST:1

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    0x00, //UCHAR bClear_Timer :1;
    //For BENQ Service Menu
    0x01,//UCHAR bHDMI_HPD : 1;
    0x00,//UCHAR bDP_HPD : 1;
    0x00,//UCHAR bDVI_HPD : 1;
    0x01,//UCHAR bAutoPower : 1;
    0x00,//UCHAR bCable : 1;
    //For BENQ Service Menu
    0x13,//UCHAR SN_len;
    0x49, //UCHAR ucSN0;    
    0x30, //UCHAR ucSN1;    
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    0x00,   //UCHAR ucTimingWriteIdx;
    FIRMWARE_VER, //USHRT usFirmwareVer;
    0x55CC, //USHRT usNvramID;
    0x55AA,//USHRT usProductMode; 
    0xFFFF, //USHRT usChkSum;
    NVRAM_USER_ADDR+sizeof(NvramUserData),
    NVRAM_CALIB_ADDR+sizeof(NvramCalibData),
    NVRAM_SYSTEM_ADDR+sizeof(NvramSystemData),
    NVRAM_FIELD_END_FLAG  //USHRT usSysEnd;
};

//******************************************************************************
// S T A T I C   V A R I A B L E S
//******************************************************************************


#define DefaultEDID OFF

#if ENABLE_AUTO_CONTROL == ON||USE_INTERNAL_EDID
#undef DefaultEDID
#define DefaultEDID ON
#endif

#if DefaultEDID == ON
static code UCHAR _Default_VGA_EDID[128]={
/*1680x1050
	0x00,0xFF,0xFF,0xFF,0xFF,0xFF,0xFF,0x00,0x41,0x0C,0x6F,0x08,0x01,0x00,0x00,0x00,
	0x07,0x12,0x01,0x03,0x0E,0x2F,0x1D,0x78,0xEE,0xB5,0x05,0xA5,0x56,0x4A,0x9A,0x25,
	0x12,0x50,0x54,0xBF,0xEF,0x80,0xB3,0x00,0x81,0x80,0x81,0x8F,0x95,0x00,0x95,0x0F,
	0xB3,0x0F,0xA9,0x40,0xA9,0x4F,0x08,0x39,0x90,0x30,0x62,0x1A,0x27,0x40,0x68,0xB0,
	0x36,0x00,0xDA,0x28,0x11,0x00,0x00,0x1E,0x00,0x00,0x00,0xFF,0x00,0x43,0x53,0x33,
	0x30,0x37,0x31,0x35,0x30,0x30,0x30,0x30,0x30,0x31,0x00,0x00,0x00,0xFC,0x00,0x50,
	0x68,0x69,0x6C,0x69,0x70,0x73,0x20,0x32,0x32,0x30,0x53,0x57,0x00,0x00,0x00,0xFD,
	0x00,0x38,0x4C,0x1E,0x53,0x11,0x00,0x0A,0x20,0x20,0x20,0x20,0x20,0x20,0x00,0x09,
*/
//1920x1080
    /*
    0x00,0xFF,0xFF,0xFF,0xFF,0xFF,0xFF,0x00,0x3A,0xD4,0x01,0x27,0x01,0x00,0x00,0x00,
    0x0A,0x17,0x01,0x03,0x6C,0x2F,0x1A,0x78,0x2A,0xE6,0x15,0xA6,0x55,0x49,0x99,0x27,
    0x13,0x50,0x54,0x2F,0x6F,0x00,0x71,0x4F,0x81,0x80,0x81,0x8A,0x95,0x00,0x95,0x0F,
    0xB3,0x00,0xD1,0xC0,0x01,0x01,0x02,0x3A,0x80,0x18,0x71,0x38,0x2D,0x40,0x58,0x2C,
    0x45,0x00,0xDC,0x0C,0x11,0x00,0x00,0x1E,0x00,0x00,0x00,0xFF,0x00,0x0A,0x20,0x20,
    0x20,0x20,0x20,0x20,0x20,0x20,0x20,0x20,0x20,0x20,0x00,0x00,0x00,0xFD,0x00,0x38,
    0x4C,0x18,0x53,0x11,0x00,0x0A,0x20,0x20,0x20,0x20,0x20,0x20,0x00,0x00,0x00,0xFC,
    0x00,0x4E,0x56,0x54,0x20,0x44,0x45,0x4D,0x4F,0x0A,0x20,0x20,0x20,0x20,0x00,0xD7,
    */
//2560x1440
/*
    0x00,0xFF,0xFF,0xFF,0xFF,0xFF,0xFF,0x00,0x09,0xD1,0xD6,0x78,0x01,0x01,0x01,0x01,
    0x04,0x18,0x01,0x03,0x0E,0x3C,0x22,0x78,0x2E,0x0C,0xD5,0xA9,0x55,0x4C,0xA1,0x25,
    0x0D,0x50,0x54,0xA5,0x6F,0x80,0x81,0x80,0x81,0xC0,0x81,0x00,0xA9,0xC0,0xB3,0x00,
    0xD1,0xC0,0x01,0x01,0x01,0x01,0x8B,0x5B,0x00,0x50,0xA0,0xA0,0x29,0x50,0x08,0x20,
    0xB8,0x04,0x55,0x50,0x21,0x00,0x00,0x1A,0x00,0x00,0x00,0xFF,0x00,0x0A,0x20,0x20,
    0x20,0x20,0x20,0x20,0x20,0x20,0x20,0x20,0x20,0x20,0x00,0x00,0x00,0xFD,0x00,0x32,
    0x4C,0x1E,0x53,0x15,0x00,0x0A,0x20,0x20,0x20,0x20,0x20,0x20,0x00,0x00,0x00,0xFC,
    0x00,0x42,0x65,0x6E,0x51,0x20,0x47,0x57,0x32,0x37,0x36,0x35,0x0A,0x20,0x00,0xD9,
 */
 	0x00,0xFF,0xFF,0xFF,0xFF,0xFF,0xFF,0x00,
	
	0x5A,0x63,0x33,0x16,0x01,0x01,0x01,0x01,
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	0x53,0x65,0x72,0x69,0x65,0x73,0x00,0xD9,
};

static code UCHAR _Default_DVI_EDID[128]={
#if 0
    0x00,0xFF,0xFF,0xFF,0xFF,0xFF,0xFF,0x00,0x09,0xD1,0x27,0x78,0x45,0x54,0x00,0x00,
    0x17,0x0E,0x01,0x03,0x80,0x33,0x1D,0x78,0x2E,0xEE,0x95,0xA3,0x54,0x4C,0x99,0x26,
    0x0F,0x50,0x54,0xA5,0x6B,0x80,0x61,0xC0,0x81,0xC0,0x81,0x40,0x81,0x80,0x95,0x00,
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    0x00,0x35,0x36,0x34,0x34,0x35,0x36,0x36,0x34,0x35,0x34,0x35,0x0A,0x20,0x00,0x38,
#elif 0
	0x00,0xFF,0xFF,0xFF,0xFF,0xFF,0xFF,0x00,0x41,0x0C,0x68,0x08,0x01,0x01,0x01,0x01,
	0x27,0x13,0x01,0x03,0x80,0x2F,0x1D,0x78,0xEE,0xB5,0x05,0xA5,0x56,0x4A,0x9A,0x25,
	0x12,0x50,0x54,0xBF,0xEF,0x80,0x95,0x00,0x95,0x0F,0x81,0x8F,0x81,0x80,0xB3,0x00,
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	0x00,0x38,0x4C,0x1E,0x53,0x11,0x00,0x0A,0x20,0x20,0x20,0x20,0x20,0x20,0x00,0xD3,
#endif
//benq 3206Q
#if 0 // 0 test //
//启动到桌面无信号
    0x00,0xFF,0xFF,0xFF,0xFF,0xFF,0xFF,0x00,
    
    0x09,0xD1,0x44,0x7B,0x01,0x00,0x00,0x00,
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    0x38,0x39,0x30,0x31,0x32,0x33,0x00,0x13,
    
#elif 0
//开始就无信号然后无法进待机
	0x00,0xFF,0xFF,0xFF,0xFF,0xFF,0xFF,0x00,
	
	0x09,0xD1,0x44,0x7B,0x01,0x00,0x00,0x00,
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	0x38,0x39,0x30,0x31,0x32,0x33,0x00,0x19,
	
#else
#if 0
	//开始就无信号然后无法进待机
	0x00,0xFF,0xFF,0xFF,0xFF,0xFF,0xFF,0x00,
	0x10,0xAC,0x91,0xA0,0x4C,0x55,0x37,0x30,
	0x34,0x17,0x01,0x03,0x80,0x3C,0x22,0x78,
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	0x20,0x20,0x20,0x20,0x20,0x20,0x00,0x96,
#else
0x00,0xFF,0xFF,0xFF,0xFF,0xFF,0xFF,0x00,0x09,0xD1,0x44,0x7B,0x01,0x00,0x00,0x00,
0x2A,0x1A,0x01,0x03,0x80,0x46,0x27,0x78,0xEA,0xCA,0x95,0xA6,0x55,0x4E,0xA1,0x26,
0x0F,0x50,0x54,0xBF,0xCF,0x80,0x71,0x4F,0x81,0x80,0x81,0xC0,0xA9,0xC0,0xB3,0x00,
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0x00,0x31,0x32,0x33,0x34,0x35,0x36,0x37,0x38,0x39,0x30,0x31,0x32,0x33,0x00,0x65, 




#endif
#endif


};

static code UCHAR _Default_HDMI_EDID[256]={
#if 1
    /*
    0x00, 0xFF, 0xFF, 0xFF, 0xFF, 0xFF, 0xFF, 0x00, 0x09, 0xD1, 0x25, 0x78, 0x45, 0x54, 0x00, 0x00,                               
    0x24, 0x12, 0x01, 0x03, 0x80, 0x35, 0x1E, 0x78, 0x2E, 0x60, 0x81, 0xA6, 0x56, 0x4A, 0x9C, 0x25,                               
    0x12, 0x50, 0x54, 0xA5, 0x6B, 0x80, 0x71, 0x00, 0x81, 0xC0, 0x81, 0x40, 0x81, 0x80, 0xA9, 0xC0,                               
    0xB3, 0x00, 0xD1, 0xC0, 0x01, 0x01, 0x02, 0x3A, 0x80, 0x18, 0x71, 0x38, 0x2D, 0x40, 0x58, 0x2C,                               
    0x45, 0x00, 0x13, 0x2B, 0x21, 0x00, 0x00, 0x1A, 0x00, 0x00, 0x00, 0xFF, 0x00, 0x30, 0x30, 0x30,                               
    0x30, 0x30, 0x30, 0x30, 0x30, 0x53, 0x4C, 0x30, 0x0A, 0x20, 0x00, 0x00, 0x00, 0xFD, 0x00, 0x32,                               
    0x4C, 0x18, 0x53, 0x11, 0x00, 0x0A, 0x20, 0x20, 0x20, 0x20, 0x20, 0x20, 0x00, 0x00, 0x00, 0xFC,                               
    0x00, 0x42, 0x65, 0x6E, 0x51, 0x20, 0x45, 0x57, 0x32, 0x34, 0x33, 0x30, 0x0A, 0x20, 0x01, 0x7B,                               
    0x02, 0x03, 0x22, 0xF1, 0x4F, 0x90, 0x05, 0x04, 0x03, 0x02, 0x01, 0x11, 0x12, 0x13, 0x14, 0x06,                               
    0x07, 0x15, 0x16, 0x1F, 0x23, 0x09, 0x07, 0x07, 0x65, 0x03, 0x0C, 0x00, 0x10, 0x00, 0x83, 0x01,                               
    0x00, 0x00, 0x02, 0x3A, 0x80, 0x18, 0x71, 0x38, 0x2D, 0x40, 0x58, 0x2C, 0x45, 0x00, 0x13, 0x2B,                               
    0x21, 0x00, 0x00, 0x1F, 0x01, 0x1D, 0x80, 0x18, 0x71, 0x1C, 0x16, 0x20, 0x58, 0x2C, 0x25, 0x00,                               
    0x13, 0x2B, 0x21, 0x00, 0x00, 0x9F, 0x01, 0x1D, 0x00, 0x72, 0x51, 0xD0, 0x1E, 0x20, 0x6E, 0x28,                               
    0x55, 0x00, 0x13, 0x2B, 0x21, 0x00, 0x00, 0x1E, 0x8C, 0x0A, 0xD0, 0x8A, 0x20, 0xE0, 0x2D, 0x10,                               
    0x10, 0x3E, 0x96, 0x00, 0x13, 0x2B, 0x21, 0x00, 0x00, 0x18, 0x00, 0x00, 0x00, 0x00, 0x00, 0x00,                               
    0x00, 0x00, 0x00, 0x00, 0x00, 0x00, 0x00, 0x00, 0x00, 0x00, 0x00, 0x00, 0x00, 0x00, 0x00, 0xE7,
    */
    //2560x1440
#if ENABLE_FREESYNC_DEMO == ON
0x00,0xFF,0xFF,0xFF,0xFF,0xFF,0xFF,0x00,0x05,0xE3,0x6A,0x24,0xB5,0x69,0x0F,0x00,
0x08,0x1A,0x01,0x03,0x80,0x35,0x1E,0x78,0x2A,0xF6,0xE5,0xA7,0x53,0x4D,0x99,0x24,
0x14,0x50,0x54,0xBF,0xEF,0x00,0xD1,0xC0,0xB3,0x00,0x95,0x00,0x81,0x80,0x81,0x40,
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0x00,0x00,0x00,0x00,0x00,0x00,0x00,0x00,0x00,0x00,0x00,0x00,0x00,0x00,0x00,0xB5,
#else
#if 0
    0x00,0xff,0xff,0xff,0xff,0xff,0xff,0x00,0x4c,0x2d,0xcb,0x0b,0x31,0x37,0x4c,0x30,
    0x2e,0x18,0x01,0x03,0x80,0x47,0x28,0x78,0x2a,0xd6,0x91,0xa7,0x55,0x4e,0xa0,0x25,
    0x0c,0x50,0x54,0xbf,0xef,0x80,0x71,0x4f,0x81,0x00,0x81,0xc0,0x81,0x80,0x95,0x00,
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    0x00,0x00,0x00,0x00,0x00,0x00,0x00,0x00,0x00,0x00,0x00,0x00,0x00,0x00,0x00,0xa2,
#elif 0
	0x00,0xFF,0xFF,0xFF,0xFF,0xFF,0xFF,0x00,
	0x5A,0x63,0x33,0x16,0x01,0x01,0x01,0x01,
	0x01,0x1A,0x01,0x03,0x80,0x46,0x27,0x78,
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	0x2D,0x40,0x10,0x2C,0x45,0x80,0xDD,0x0C,0x11,0x00,0x00,0x1E,0x00,0x00,0x00,0x68,
#else
// benq 3206
0x00,0xFF,0xFF,0xFF,0xFF,0xFF,0xFF,0x00,

0x09,0xD1,0x44,0x7B,0x01,0x00,0x00,0x00,
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0x00,0x00,0x00,0x00,0x00,0x00,0x00,0x56,



#endif
#endif 
/*
0x00,0xFF,0xFF,0xFF,0xFF,0xFF,0xFF,0x00,0x09,0xD1,0xD6,0x78,0x01,0x01,0x01,0x01,
0x04,0x18,0x01,0x04,0xA5,0x3C,0x22,0x78,0x26,0x0C,0xD5,0xA9,0x55,0x4C,0xA1,0x25,
0x0D,0x50,0x54,0xA5,0x6F,0x80,0x81,0x80,0x81,0xC0,0x81,0x00,0xA9,0xC0,0xB3,0x00,
0xD1,0xC0,0x01,0x01,0x01,0x01,0x8B,0x5B,0x00,0x50,0xA0,0xA0,0x29,0x50,0x08,0x20,
0xB8,0x04,0x55,0x50,0x21,0x00,0x00,0x1A,0x00,0x00,0x00,0xFF,0x00,0x0A,0x20,0x20,
0x20,0x20,0x20,0x20,0x20,0x20,0x20,0x20,0x20,0x20,0x00,0x00,0x00,0xFD,0x00,0x32,
0x4C,0x1E,0x53,0x15,0x00,0x0A,0x20,0x20,0x20,0x20,0x20,0x20,0x00,0x00,0x00,0xFC,
0x00,0x42,0x65,0x6E,0x51,0x20,0x47,0x57,0x32,0x37,0x36,0x35,0x0A,0x20,0x01,0x48,
0x02,0x03,0x22,0xF1,0x4F,0x90,0x1F,0x05,0x14,0x04,0x13,0x03,0x12,0x07,0x16,0x15,
0x01,0x06,0x11,0x02,0x23,0x09,0x07,0x07,0x83,0x01,0x00,0x00,0x65,0x03,0x0C,0x00,
0x10,0x00,0x02,0x3A,0x80,0x18,0x71,0x38,0x2D,0x40,0x58,0x2C,0x45,0x00,0x56,0x50,
0x21,0x00,0x00,0x1F,0x01,0x1D,0x80,0x18,0x71,0x1C,0x16,0x20,0x58,0x2C,0x25,0x00,
0x56,0x50,0x21,0x00,0x00,0x9F,0x01,0x1D,0x00,0x72,0x51,0xD0,0x1E,0x20,0x6E,0x28,
0x55,0x00,0x56,0x50,0x21,0x00,0x00,0x1E,0x8C,0x0A,0xD0,0x8A,0x20,0xE0,0x2D,0x10,
0x10,0x3E,0x96,0x00,0x56,0x50,0x21,0x00,0x00,0x18,0x00,0x00,0x00,0x00,0x00,0x00,
0x00,0x00,0x00,0x00,0x00,0x00,0x00,0x00,0x00,0x00,0x00,0x00,0x00,0x00,0x00,0x47,
*/
#elif 0
//HDMI 1.3 EDID
    0x00,0xFF,0xFF,0xFF,0xFF,0xFF,0xFF,0x00,0x3A,0xD4,0x76,0x06,0x01,0x00,0x00,0x00,
    0x0C,0x13,0x01,0x03,0x80,0x0C,0x09,0x78,0x0A,0x1E,0xAC,0x98,0x59,0x56,0x85,0x28,
    0x29,0x52,0x57,0x00,0x00,0x00,0x01,0x01,0x01,0x01,0x01,0x01,0x01,0x01,0x01,0x01,
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    0x40,0x55,0x00,0x81,0x60,0x00,0x00,0x00,0x18,0x00,0x00,0x00,0x00,0x00,0x00,0x5B,
#else
//HDMI 1.4 3D EDID
    0x00,0xff,0xff,0xff,0xff,0xff,0xff,0x00,0x4d,0xd9,0x01,0xf8,0x01,0x01,0x01,0x01,
    0x01,0x14,0x01,0x03,0x80,0x90,0x51,0x78,0x0a,0x0d,0xc9,0xa0,0x57,0x47,0x98,0x27,
    0x12,0x48,0x4c,0x21,0x08,0x00,0x81,0x80,0x01,0x01,0x01,0x01,0x01,0x01,0x01,0x01,
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    0x25,0x00,0xa0,0x2a,0x53,0x00,0x00,0x9e,0x00,0x00,0x00,0x00,0x00,0x00,0x00,0xf9,
#endif
};
#endif

//******************************************************************************
// E X T E R N A L   V A R I A B L E   P R O T O T Y P E S
//******************************************************************************

//******************************************************************************
// S T A T I C   F U N C T I O N   P R O T O T Y P E S
//******************************************************************************
static UCHAR NvramIsEmpty(void);
static void NvramValidCheck(void);
static void NvramClearAll(void);
static void NvramWpOn(void);
static void NvramWpOff(void);

//******************************************************************************
// E X T E R N A L   F U N C T I O N   P R O T O T Y P E S
//******************************************************************************

//******************************************************************************
// F U N C T I O N   B O D Y S
//******************************************************************************

/**************************************************************************//**
 * Write the data to NVRam.
 * @param addr Address in NVRam.
 * @param len Length of the data array.
 * @param ptr Pointer to the data array.
 ******************************************************************************/
void NvramWrite(USHRT addr, USHRT len, UCHAR *ptr)
{
#if ENABLE_FE2P == ON
    FE2P_NvramWrite(addr, len, ptr);
#else
    #define PAGE_SIZE   16
    UCHAR slave, remainder;
    USHRT local_timer;

    NvramWpOff();
    while (len) {
        remainder = PAGE_SIZE - (addr % PAGE_SIZE);
        if (remainder > len) {
            remainder = len;
        }
        slave =  NVRAM_ADDR | (UCHAR)((addr>>7) & 0x0E);
        NvramWriteIICSeq(slave, addr, remainder, ptr);
        addr += remainder;
        ptr += remainder;
        len -= remainder;
        local_timer = GetTimerTick();
        do {
            if (NvramCheckDevice(NVRAM_ADDR)) {
                break;
            }
        } while ((GetTimerTick()-local_timer) < 20);
    }
    NvramWpOn();
#endif
}

/**************************************************************************//**
 * Read the data from NVRam.
 * @param addr Address in NVRam.
 * @param len Length of the data array.
 * @param[out] ptr Pointer to the data array.
 ******************************************************************************/
void NvramRead(USHRT addr, USHRT len, UCHAR *ptr)
{
#if ENABLE_FE2P == ON
    FE2P_NvramRead(addr, len, ptr);
#else
    UCHAR slave;

    slave = NVRAM_ADDR | (((UCHAR)(addr>>8)) << 1);
    NvramReadIICSeq(slave, addr, len, ptr);
#endif
}

/**************************************************************************//**
 * Check the NVRam is empty or not
 * If NVRam is empty, load default values.
 * If NVRam is no empty, read back the user/system/... data from NVRam.
 ******************************************************************************/
void NvramLoadData(void)
{
    if (NvramIsEmpty() == NVRAM_UPDATE_ALL) {
        NvramClearAll(); //To avoid previous wrong Nvram data
        NvramInitialize(NVRAM_UPDATE_ALL);
#if ENABLE_FE2P == ON
        EraseTimeScale();
#endif
    }
    else if (NvramIsEmpty() == NVRAM_UPDATE_USER) {
        NvramClearTiming(); //To avoid previous wrong Nvram data
        NvramInitialize(NVRAM_UPDATE_USER);
    }
    NvramReadUserData(&UserData);
    NvramReadCalibData(&CalibData);
    NvramReadSystemData(&SystemData);
	
    NvramValidCheck();
    //...
#if ENABLE_FE2P == ON
    DecodeTimeScale();
#endif
}

/**************************************************************************//**
 * Check the NVRam is empty or not.
 * @return TRUE if NVRam is empty else FALSE.
 ******************************************************************************/
static UCHAR NvramIsEmpty(void)
{
    NvramSystemData system_data;
    USHRT nvram_id;

    do {
        NvramReadSystemData(&system_data);
        nvram_id = system_data.usNvramID;
        NvramReadSystemData(&system_data);
    } while (nvram_id != system_data.usNvramID);

    if (nvram_id != SystemDataDefault.usNvramID) {
        return NVRAM_UPDATE_ALL;
    }
    else if (system_data.usNVSysSize != SystemDataDefault.usNVSysSize) {
        return NVRAM_UPDATE_ALL;
    }
    else if (system_data.usNVCalSize != SystemDataDefault.usNVCalSize) {
        return NVRAM_UPDATE_ALL;
    }
    else if (system_data.usNVUsrSize != SystemDataDefault.usNVUsrSize) {
        return NVRAM_UPDATE_USER;
    }
    else if (system_data.usFirmwareVer != SystemDataDefault.usFirmwareVer) {
        return NVRAM_UPDATE_USER;
    }
#if ENABLE_EMBEDDED_CHECKSUM == ON
    else if (system_data.usChkSum != GetEmbeddedCheckSum()) {
        return NVRAM_UPDATE_USER;
    }
#endif
    else {
        return NVRAM_UPDATE_FREE;
    }
}

/**************************************************************************//**
 * Check size/address/the number of field are valid or not.
 * If the deployment of NVRam is invalid, hold the system!
 ******************************************************************************/
static void NvramValidCheck(void)
{
    if (UserDataDefault.usUsrEnd != NVRAM_FIELD_END_FLAG) {
        while(1);
    }
    if (CalibDataDefault.usCalEnd != NVRAM_FIELD_END_FLAG) {
        while(1);
    }
    if (SystemDataDefault.usSysEnd != NVRAM_FIELD_END_FLAG) {
        while(1);
    }
    if (sizeof(NvramUserData) > NVRAM_USER_SIZE) {
        while(1);
    }
    if (sizeof(NvramCalibData) > NVRAM_CALIB_SIZE) {
        while(1);
    }
    if (sizeof(NvramSystemData) > NVRAM_SYSTEM_SIZE) {
        while(1);
    }
}

/**************************************************************************//**
 * Load the default to NVRam.
 * @param type Update type.
 ******************************************************************************/
void NvramInitialize(UCHAR type)
{
    NvramUserData user_data;
    NvramCalibData calib_data;
    NvramSystemData system_data;

    user_data = UserDataDefault;
    if (type == NVRAM_UPDATE_ALL) {
        calib_data = CalibDataDefault;
        system_data = SystemDataDefault;
    }
    else {
        NvramReadSystemData(&system_data);
        system_data.usFirmwareVer = SystemDataDefault.usFirmwareVer;
        system_data.ucTimingWriteIdx = SystemDataDefault.ucTimingWriteIdx;
        system_data.usNVUsrSize = SystemDataDefault.usNVUsrSize;
        system_data.usNVCalSize = SystemDataDefault.usNVCalSize;
        system_data.usNVSysSize = SystemDataDefault.usNVSysSize;
    }

#if ENABLE_EMBEDDED_CHECKSUM == ON
    system_data.usChkSum = GetEmbeddedCheckSum();
#endif
    
    NvramWriteUserData(&user_data);
    if (type == NVRAM_UPDATE_ALL) {
        NvramWriteCalibData(&calib_data);
    }
    NvramWriteSystemData(&system_data);
}

/**************************************************************************//**
 * Initialize the whole NVRam to 0xFF.
 ******************************************************************************/
static void NvramClearAll(void)
{
    UCHAR init_data[16] = {
        0xFF, 0xFF, 0xFF, 0xFF, 0xFF, 0xFF, 0xFF, 0xFF,
        0xFF, 0xFF, 0xFF, 0xFF, 0xFF, 0xFF, 0xFF, 0xFF,
    };
    USHRT i;
    
    for (i=0; i<((NVRAM_END+1)/16); i++) {
        NvramWrite(16*i, 16, init_data);
    }
}

/**************************************************************************//**
 * Initialize the timing area in NVRam to 0xFF.
 ******************************************************************************/
void NvramClearTiming(void)
{
    UCHAR init_data[16] = { 
        0xFF, 0xFF, 0xFF, 0xFF, 0xFF, 0xFF, 0xFF, 0xFF,
        0xFF, 0xFF, 0xFF, 0xFF, 0xFF, 0xFF, 0xFF, 0xFF,
    };
    USHRT i;
    
    for (i = 0; i < (NVRAM_TIMING_AREA / 16); i++) {
        NvramWrite(i * 16 + NVRAM_TIMING_ADDR, 16, init_data);
    }
}

/**************************************************************************//**
 * Read back the timing data from Nvram.
 * @param[out] ptr Pointer to the timing data buffer.
 ******************************************************************************/
BOOL NvramReadTimingData(InputTimingFormat *ptr)
{
    BOOL found=FALSE;
    UCHAR i, nvram_timing_size;
    USHRT nvram_start_addr;
    NvramTimingFormat nvram;

    nvram_timing_size = (UCHAR) sizeof(NvramTimingFormat);
    for (i=0; i<(NVRAM_TIMING_AREA/nvram_timing_size); i++) {
        nvram_start_addr = (USHRT) NVRAM_TIMING_ADDR + i*nvram_timing_size;
        NvramRead(nvram_start_addr, nvram_timing_size, (UCHAR *)&nvram);
        if (ptr->usModeIndex == nvram.usModeIndex) { //We found current mode in NVRAM
            found = TRUE;
            break;
        }
    }

    if (found == TRUE) {
        ptr->usHTotal = nvram.usHTotal;
        ptr->usHStart = nvram.usHStart;
        ptr->usVStart = nvram.usVStart;
        ptr->usHTotal50 = nvram.usHTotal50;
        ptr->usHStart50 = nvram.usHStart50;
        ptr->usVStart50 = nvram.usVStart50;
        ptr->ucPhase = nvram.ucPhase;
        ptr->ucAutoTune = nvram.ucAutoTune;
        return TRUE;
    }
    else {
        return FALSE;
    }
}

/**************************************************************************//**
 * Write the timing data to NVRam.
 * @param ptr Pointer to the timing data buffer.
 ******************************************************************************/
void NvramWriteTimingData(InputTimingFormat *ptr)
{
    BOOL found=FALSE;
    UCHAR i, nvram_timing_size;
    USHRT nvram_start_addr;
    NvramTimingFormat nvram;

    nvram_timing_size = (UCHAR) sizeof(NvramTimingFormat);
    for (i=0; i<(NVRAM_TIMING_AREA/nvram_timing_size); i++) {
        nvram_start_addr = (USHRT) NVRAM_TIMING_ADDR + i*nvram_timing_size;
        NvramRead(nvram_start_addr, nvram_timing_size, (UCHAR *)&nvram);
        if (nvram.usModeIndex == ptr->usModeIndex) { //Found the same mode index in Nvram
            found = TRUE;
            break;
        }
    }

    nvram.usHTotal = ptr->usHTotal;
    nvram.usHStart = ptr->usHStart;
    nvram.usVStart = ptr->usVStart;
    nvram.usHTotal50 = ptr->usHTotal50;
    nvram.usHStart50 = ptr->usHStart50;
    nvram.usVStart50 = ptr->usVStart50;
    nvram.ucPhase = ptr->ucPhase;
    nvram.ucAutoTune = ptr->ucAutoTune;
    nvram.usModeIndex = ptr->usModeIndex;
    
    if (found == FALSE) {
        nvram_start_addr = (USHRT) NVRAM_TIMING_ADDR + SystemData.ucTimingWriteIdx*nvram_timing_size;
        //Update system data
        SystemData.ucTimingWriteIdx = (SystemData.ucTimingWriteIdx+1) % (NVRAM_TIMING_AREA/nvram_timing_size);
        NvramWriteSystemData(&SystemData);
    }
    NvramWrite(nvram_start_addr, nvram_timing_size, (UCHAR *)&nvram);
}

/**************************************************************************//**
 * Read back the user data from Nvram.
 * @param[out] ptr Pointer to the user data buffer.
 ******************************************************************************/
void NvramReadUserData(NvramUserData *ptr)
{
    NvramRead(NVRAM_USER_ADDR, sizeof(NvramUserData), (UCHAR *)ptr);
}

/**************************************************************************//**
 * Write the user data to Nvram.
 * @param ptr Pointer to the user data buffer.
 ******************************************************************************/
void NvramWriteUserData(NvramUserData *ptr)
{
   NvramWrite(NVRAM_USER_ADDR, sizeof(NvramUserData), (UCHAR *)ptr);
}

/**************************************************************************//**
 * Read back the calibration data from Nvram.
 * @param[out] ptr Pointer to the calibration data buffer.
 ******************************************************************************/
void NvramReadCalibData(NvramCalibData *ptr)
{
    NvramRead(NVRAM_CALIB_ADDR, sizeof(NvramCalibData), (UCHAR *)ptr);
}

/**************************************************************************//**
 * Write the calibration data to Nvram.
 * @param ptr Pointer to the calibration data buffer.
 ******************************************************************************/
void NvramWriteCalibData(NvramCalibData *ptr)
{
    NvramWrite(NVRAM_CALIB_ADDR, sizeof(NvramCalibData), (UCHAR *)ptr);
}

/**************************************************************************//**
 * Read back the system data from Nvram.
 * @param[out] ptr Pointer to the system data buffer.
 ******************************************************************************/
void NvramReadSystemData(NvramSystemData *ptr)
{
    NvramRead(NVRAM_SYSTEM_ADDR, sizeof(NvramSystemData), (UCHAR *)ptr);
}

/**************************************************************************//**
 * Write the system data to Nvram.
 * @param ptr Pointer to the system data buffer.
 ******************************************************************************/
void NvramWriteSystemData(NvramSystemData *ptr)
{
    NvramWrite(NVRAM_SYSTEM_ADDR, sizeof(NvramSystemData), (UCHAR *)ptr);
}

//******************************************************************************
// Prototype: 
//  void NvramDumpToSram(void)
// Parameters:
//  void
// Return:
//  None
// Purpose:
//  Dump the Nvram data to SRAM
// Notes:
//  None
//******************************************************************************
/*
xdata UCHAR SramArea[2048] _at_ 0xA800;
void NvramDumpToSram(void)
{
    NvramRead(0, sizeof(SramArea), SramArea);
}
*/

#if ENABLE_HDCP == ON
#if ENABLE_NVT_HDCP_WRITER == ON
/**************************************************************************//**
 * Write the HDCP data to Nvram.
 * @param ptr Pointer to HDCP data.
 ******************************************************************************/
void NvramWriteHDCPdata(UCHAR *ptr)
{
    NvramWrite(NVRAM_HDCP_ADDR, NUM_HDCP_TOTAL, ptr);
}
#endif
/**************************************************************************//**
 * Read back the HDCP data from Nvram.
 * @param[out] ptr Pointer to HDCP data buffer.
 ******************************************************************************/
void NvramReadHDCPdata(UCHAR *ptr)
{
    NvramRead(NVRAM_HDCP_ADDR, NUM_HDCP_TOTAL, ptr);
}
#endif


bit IsEdidHeader(UCHAR *EdidBuf)
{
	UCHAR i;
	UCHAR code EdidHeader[] = {0x00, 0xFF, 0xFF, 0xFF, 0xFF, 0xFF, 0xFF, 0x00};

	i = 8;
	do{
		i--;
		if (*(EdidBuf+i) != EdidHeader[i]) return 0;
		}while(i);
	return 1;
}

#if USE_INTERNAL_EDID == 1
#if VGA_DDC_CHANNEL != 0xFF
/**************************************************************************//**
 * Write the VGA EDID to Nvram
 * @param ptr Pointer to VGA EDID.
 ******************************************************************************/
void NvramWriteVGAEdid(UCHAR *ptr)
{
    NvramWrite(NVRAM_VGA_EDID_ADDR, NVRAM_VGA_EDID_AREA, ptr);
}

/**************************************************************************//**
 * Read back the VGA EDID from Nvram
 * @param[out] ptr Pointer to VGA EDID.
 ******************************************************************************/
void NvramReadVGAEdid(UCHAR *ptr)
{
    USHRT i;
#if (DefaultEDID == ON) && (!USE_INTERNAL_EDID_ALLOW_WR_EDID)
    for (i=0; i<128; i++) {
        *ptr = _Default_VGA_EDID[i];
        ptr++;
    }
#else
    NvramRead(NVRAM_VGA_EDID_ADDR, NVRAM_VGA_EDID_AREA, ptr);
	if(!IsEdidHeader(ptr))
	{
		for (i=0; i<128; i++) {
			*ptr = _Default_VGA_EDID[i];
			ptr++;
		}		
	}
#endif
}
#endif

#if DVI_DDC_CHANNEL != 0xFF
/**************************************************************************//**
 * Write the DVI EDID to Nvram
 * @param ptr Pointer to DVI EDID.
 ******************************************************************************/
void NvramWriteDVIEdid(UCHAR *ptr)
{
    NvramWrite(NVRAM_DVI_EDID_ADDR, NVRAM_DVI_EDID_AREA, ptr);
}

/**************************************************************************//**
 * Read back the DVI EDID from Nvram
 * @param[out] ptr Pointer to DVI EDID.
 ******************************************************************************/
void NvramReadDVIEdid(UCHAR *ptr)
{
    USHRT i, k;
#if (DefaultEDID == ON) && (!USE_INTERNAL_EDID_ALLOW_WR_EDID)
#if DVI_DDC_CHANNEL == 0
    if (MCU_DDC0_EDIDLEN == 0) {
        k = 128;
    }
    else {
        k = 256;
    }
#endif
#if DVI_DDC_CHANNEL == 1
    if (MCU_DDC1_EDIDLEN == 0) {
        k = 128;
    }
    else {
        k = 256;
    }
#endif
#if DVI_DDC_CHANNEL == 2
    if (MCU_DDC2_EDIDLEN == 0) {
        k = 128;
    }
    else {
        k = 256;
    }
#endif
#if DVI_DDC_CHANNEL == 3
    if (MCU_DDC3_EDIDLEN == 0) {
        k = 128;
    }
    else {
        k = 256;
    }
#endif

    if (k == 128) {
        for (i=0; i<128; i++) {
            *ptr = _Default_DVI_EDID[i];
            ptr++;
        }
    }
    else {
        for (i=0; i<256; i++) {
            *ptr = _Default_HDMI_EDID[i];
            ptr++;
        }
    }
#else
    NvramRead(NVRAM_DVI_EDID_ADDR, NVRAM_DVI_EDID_AREA, ptr);
	if(!IsEdidHeader(ptr))
	{
#if DVI_DDC_CHANNEL == 0
	    if (MCU_DDC0_EDIDLEN == 0) {
	        k = 128;
	    }
	    else {
	        k = 256;
	    }
#endif
#if DVI_DDC_CHANNEL == 1
	    if (MCU_DDC1_EDIDLEN == 0) {
	        k = 128;
	    }
	    else {
	        k = 256;
	    }
#endif
#if DVI_DDC_CHANNEL == 2
	    if (MCU_DDC2_EDIDLEN == 0) {
	        k = 128;
	    }
	    else {
	        k = 256;
	    }
#endif
#if DVI_DDC_CHANNEL == 3
	    if (MCU_DDC3_EDIDLEN == 0) {
	        k = 128;
	    }
	    else {
	        k = 256;
	    }
#endif

	    if (k == 128) {
	        for (i=0; i<128; i++) {
	            *ptr = _Default_DVI_EDID[i];
	            ptr++;
	        }
	    }
	    else {
	        for (i=0; i<256; i++) {
	            *ptr = _Default_HDMI_EDID[i];
	            ptr++;
	        }
	    }

	}
#endif
}
#endif

#if HDMI_DDC_CHANNEL != 0xFF
/**************************************************************************//**
 * Write the HDMI EDID to Nvram
 * @param ptr Pointer to HDMI EDID.
 ******************************************************************************/
void NvramWriteHDMIEdid(UCHAR *ptr)
{
    NvramWrite(NVRAM_HDMI_EDID_ADDR, NVRAM_HDMI_EDID_AREA, ptr);
}

/**************************************************************************//**
 * Read back the HDMI EDID from Nvram
 * @param[out] ptr Pointer to HDMI EDID.
 ******************************************************************************/
void NvramReadHDMIEdid(UCHAR *ptr)
{
    USHRT i;
#if (DefaultEDID == ON) && (!USE_INTERNAL_EDID_ALLOW_WR_EDID)
    for (i=0; i<256; i++) {
        *ptr = _Default_HDMI_EDID[i];
        ptr++;
    }
#else
    NvramRead(NVRAM_HDMI_EDID_ADDR, NVRAM_HDMI_EDID_AREA, ptr);
	if(!IsEdidHeader(ptr))
	{
	    for (i=0; i<256; i++) {
	        *ptr = _Default_HDMI_EDID[i];
	        ptr++;
	    }
	}
#endif
}
#endif

/**************************************************************************//**
 * Save EDID from DDC buffer to NVRam
 ******************************************************************************/
 
void NvramSaveEDID(void)
{
#if VGA_DDC_CHANNEL == 0
    NvramWriteVGAEdid(EDID_SRAM_BUFF0);
#elif VGA_DDC_CHANNEL == 1
    NvramWriteVGAEdid(EDID_SRAM_BUFF1);
#elif VGA_DDC_CHANNEL == 2
    NvramWriteVGAEdid(EDID_SRAM_BUFF2);
#elif VGA_DDC_CHANNEL == 3
    NvramWriteVGAEdid(EDID_SRAM_BUFF3);
#endif

#if DVI_DDC_CHANNEL == 0
    NvramWriteDVIEdid(EDID_SRAM_BUFF0);
#elif DVI_DDC_CHANNEL == 1
    NvramWriteDVIEdid(EDID_SRAM_BUFF1);
#elif DVI_DDC_CHANNEL == 2
    NvramWriteDVIEdid(EDID_SRAM_BUFF2); //DVI
#elif DVI_DDC_CHANNEL == 3
    NvramWriteDVIEdid(EDID_SRAM_BUFF3);
#elif DVI_DDC_CHANNEL == 4
    NvramWriteDVIEdid(EDID_SRAM_BUFF4);  // feng-160823
#endif

#if HDMI_DDC_CHANNEL == 0
    NvramWriteHDMIEdid(EDID_SRAM_BUFF0);
#elif HDMI_DDC_CHANNEL == 1
    NvramWriteHDMIEdid(EDID_SRAM_BUFF1);
#elif HDMI_DDC_CHANNEL == 2
    NvramWriteHDMIEdid(EDID_SRAM_BUFF2);
#elif HDMI_DDC_CHANNEL == 3
    NvramWriteHDMIEdid(EDID_SRAM_BUFF3);
#elif HDMI_DDC_CHANNEL == 4
    NvramWriteHDMIEdid(EDID_SRAM_BUFF4);// feng-160823 //HDMI
#endif

}

/**************************************************************************//**
 * Load EDID from NVRam to DDC buffer.
 ******************************************************************************/
void NvramLoadEDID(void)
{
#if VGA_DDC_CHANNEL == 0
    NvramReadVGAEdid(EDID_SRAM_BUFF0);
#elif VGA_DDC_CHANNEL == 1
    NvramReadVGAEdid(EDID_SRAM_BUFF1);
#elif VGA_DDC_CHANNEL == 2
    NvramReadVGAEdid(EDID_SRAM_BUFF2);
#elif VGA_DDC_CHANNEL == 3
    NvramReadVGAEdid(EDID_SRAM_BUFF3);
#endif

#if DVI_DDC_CHANNEL == 0
    NvramReadDVIEdid(EDID_SRAM_BUFF0);
#elif DVI_DDC_CHANNEL == 1
    NvramReadDVIEdid(EDID_SRAM_BUFF1);
#elif DVI_DDC_CHANNEL == 2
    NvramReadDVIEdid(EDID_SRAM_BUFF2);
#elif DVI_DDC_CHANNEL == 3
    NvramReadDVIEdid(EDID_SRAM_BUFF3);
#elif DVI_DDC_CHANNEL == 4
    NvramReadDVIEdid(EDID_SRAM_BUFF4); // feng-160823
#endif

#if HDMI_DDC_CHANNEL == 0
    NvramReadHDMIEdid(EDID_SRAM_BUFF0);
#elif HDMI_DDC_CHANNEL == 1
    NvramReadHDMIEdid(EDID_SRAM_BUFF1);
#elif HDMI_DDC_CHANNEL == 2
    NvramReadHDMIEdid(EDID_SRAM_BUFF2);
#elif HDMI_DDC_CHANNEL == 3
    NvramReadHDMIEdid(EDID_SRAM_BUFF3);
#elif HDMI_DDC_CHANNEL == 4
    NvramReadHDMIEdid(EDID_SRAM_BUFF4); // feng-160823
#endif

}
#endif

#if ENABLE_FE2P == OFF
/**************************************************************************//**
 * Turn on the NVRAM write protect function.
 ******************************************************************************/
static void NvramWpOn(void)
{
    McuSetIOBit(NVRAM_WP_PORT, NVRAM_WP_BIT, NVRAM_WP_ACTIVE);
}

/**************************************************************************//**
 * Turn off the NVRAM write protect function.
 ******************************************************************************/
static void NvramWpOff(void)
{
    McuSetIOBit(NVRAM_WP_PORT, NVRAM_WP_BIT, ~NVRAM_WP_ACTIVE);
}
#endif
